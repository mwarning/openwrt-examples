## example2/Config.in
```kconfig
menu "Configuration"
	depends on PACKAGE_example2

config EXAMPLE2_ENABLE_FOO
	bool "Enable Feature Foo"
	depends on PACKAGE_example2
	default y

config EXAMPLE2_ENABLE_BAR
	bool "Enable feature Bar"
	depends on PACKAGE_example2
	default n

endmenu
```

## myapp2/Config.in
```kconfig
menu "Configuration"
	depends on PACKAGE_myapp2

config MYAPP2_ENABLE_FOO
	bool "Enable Feature Foo"
	depends on PACKAGE_myapp2
	default y

config MYAPP2_ENABLE_BAR
	bool "Enable feature Bar"
	depends on PACKAGE_myapp2
	default n

endmenu
```
